## conf/distro/bbbdistro.conf
```bitbake
# meta-zk47 distro config
DISTRO = "bbbdistro"
DISTRO_NAME = "ZK47 Embedded Linux"
DISTRO_VERSION = "1.0"
DISTRO_CODENAME = "elite"
DISTRO_DESCRIPTION = "A sleek, custom Linux distro by ZK47"

# Inherit the default poky behavior
include conf/distro/poky.inc
```

## conf/layer.conf
```bitbake
# meta-bbb/conf/layer.conf

BBPATH .= ":${LAYERDIR}"
BBFILES += "${LAYERDIR}/recipes-*/*/*.bb \
           ${LAYERDIR}/recipes-*/*/*.bbappend"


BBFILE_COLLECTIONS += "meta-bbb"
BBFILE_PATTERN_meta-bbb = "^${LAYERDIR}/"
BBFILE_PRIORITY_meta-bbb = "15"
```
